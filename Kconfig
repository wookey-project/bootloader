## Kconfig
```kconfig
menu "Bootloader configuration"

config LOADER_SERIAL
  bool "Loader serial interface activated (debug mode)"
  default n
  ---help---
  This option activates the loader serial interface (mainly
  for debugging purpose).
  The loader usart interface is activated.
  Userspace applications printf content will be printed by
  the loader.
  This should be disabled in production mode.

if LOADER_SERIAL

choice
  prompt "loader console USART identifier"
  default LOADER_CONSOLE_USART1
    config LOADER_CONSOLE_USART1
    bool "loader uses USART1 for its console"
    ---help---
      In Discovery board, PB6(TX)/PB7(RX) pins are linked to UART1, if
      using motherboard DM-STF4BB, the RS232 connector is linked
      to USART6.
    config LOADER_CONSOLE_USART4
    bool "loader uses USART4 for its console"
    ---help---
      In Discovery board, PB6(TX)/PB7(RX) pins are linked to UART1, if
      using motherboard DM-STF4BB, the RS232 connector is linked
      to USART4.
  config LOADER_CONSOLE_USART6
    bool "loader uses USART6 for its console"
    ---help---
      In Discovery board, PB6(TX)/PB7(RX) pins are linked to UART1, if
      using motherboard DM-STF4BB, the RS232 connector is linked
      to USART6.
endchoice

config LOADER_USART
  int
  default 1 if LOADER_CONSOLE_USART1
  default 4 if LOADER_CONSOLE_USART4
  default 6 if LOADER_CONSOLE_USART6


config LOADER_EXTRA_DEBUG
  bool "Enable extra debugging informations"
  default n
  ---help---
  Print extra debugging information on the serial console, like
  automaton states and transitions

config LOADER_ALLOW_SERIAL_RX
  bool "Enable loader RX line IRQ (debug purpose)"
  default n
  ---help---
  Allow the RX line to be used in the loader. This is by default
  disabled for security reasons: you can activate it for debug
  purposes.

endif

config LOADER_MOCKUP
    bool "Enable bootloader mockup mode"

if LOADER_MOCKUP

config LOADER_MOCKUP_DFU
    bool "Start in DFU mode"
    ---help---
      Boot in DFU mode of the eligible firmware automatically. This
      behavor replace a manual push on the DFU button at boot time.
      The loader boots the DFU mode of the currently eligible firmware


endif

config LOADER_FW_HASH_CHECK
    bool "Check firmware integrity at boot"
    ---help---
      Check that the Firmware image that is going to be booted is
      checked for integrity, using the hash data of the firmware header to
      compare with.
      This does not deactivate the CRC32 check of the firmware
      header structure

config LOADER_FLASH_LOCK
   bool "Lock flash banks at boot time"
   default y
   ---help---
      Lock current flash bank write access in DFU mode (allowing other
      bank update) and all banks write access in nominal mode.

config LOADER_FLASH_RDP_CHECK
   bool "Check that RDP protection is active at boot time"
   default n
   ---help---
      Check if the RDP protection flag is active at boot.
      If RDP protection is not active, then reset the board.

config LOADER_ERASE_ON_SECBREACH
   bool "Erase flash on Security breach detection"
   default y
   ---help---
      If the bootloader detect a security breach (SECBREACH state), the flash
      is erased to protect assets. In RDP2 mode, the device is broken.

if LOADER_ERASE_ON_SECBREACH

config LOADER_ERASE_WITH_RECOVERY
   bool "Handle reset while erasing"
   default n
   ---help---
     If the device resets while the bootloader is in security erase mode, handle
     flash erase continuation at bootup, using One Time Programable flash blocks
     to handle current erase state.

if LOADER_ERASE_WITH_RECOVERY

config LOADER_EMULATE_OTP
   bool "Emulate OTP"
   default n
   ---help---
     OTP in emulation mode, meaning that they are never "locked". This is useful to
     "debug" the mass erase feature, but this must not be selected in production mode!

endif

endif


config LOADER_HANDLE_BKPSRAM
   bool "Handle Backup SRAM copy for firmware (security enhanced mechanism)"
   default n


config LOADER_USE_PVD
   bool "Use PVD (Power Voltage Detection) as defense in depth against glitches"
   default y
   ---help---
      Use the STM32 Power Voltage Detection to try to detect voltage or EM
      glitches.

choice
  prompt "loader behavior on invalid control flow detection"
  default LOADER_INVAL_CFLOW_GOTO_ERROR
    config LOADER_INVAL_CFLOW_GOTO_ERROR
      bool "Error state on invalid control flow"
      ---help---
      Goto error state on invalid control flow detection.
      Usually generates a reset or hang the execution.
    config LOADER_INVAL_CFLOW_GOTO_SECBREACH
      bool "Security breach state on invalid control flow"
      ---help---
      Goto secbreach state on invalid control flow detection.
      May generate upto the flash memory erase.
endchoice

endmenu
```
